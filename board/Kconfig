## board/Kconfig
```kconfig
menu "Hardware Drivers Config"

config SOC_STM32F103VE
    bool
    select SOC_SERIES_STM32F1
    select RT_USING_COMPONENTS_INIT
    select RT_USING_USER_MAIN
    default y

menu "Onboard Peripheral Drivers"

endmenu

menu "On-chip Peripheral Drivers"

    config BSP_USING_GPIO
        bool "Enable GPIO"
        select RT_USING_PIN
        default y
		
	config BSP_USING_ON_CHIP_FLASH
        bool "Enable on-chip FLASH"
        default n
		
    menuconfig BSP_USING_UART
        bool "Enable UART"
        default y
        select RT_USING_SERIAL
        if BSP_USING_UART
            config BSP_USING_UART1
                bool "Enable UART1"
                default y
				
			config BSP_UART1_TX_USING_DMA
                bool "Enable UART1 TX DMA"
                depends on BSP_USING_UART1 && RT_SERIAL_USING_DMA
                default n
				
		    config BSP_UART1_RX_USING_DMA
                bool "Enable UART1 RX DMA"
                depends on BSP_USING_UART1 && RT_SERIAL_USING_DMA
                default n
				
			config BSP_UART1_TX_BUFSIZE
				int "Set UART1 TX buffer size"
				range 0 2048
				default 128	
			
			config BSP_UART1_RX_BUFSIZE
				int "Set UART1 RX buffer size"
				range 0 2048
				default 128
				
			config BSP_USING_UART3
                bool "Enable UART3"
                default y
			
			config BSP_UART3_TX_USING_DMA
                bool "Enable UART3 TX DMA"
                depends on BSP_USING_UART3 && RT_SERIAL_USING_DMA
                default n
				
			config BSP_UART3_RX_USING_DMA
                bool "Enable UART3 RX DMA"
                depends on BSP_USING_UART3 && RT_SERIAL_USING_DMA
                default n
				
			config BSP_UART3_TX_BUFSIZE
				int "Set UART3 TX buffer size"
				range 0 2048
				default 128
			
			config BSP_UART3_RX_BUFSIZE
				int "Set UART3 RX buffer size"
				range 0 2048
				default 128
		
        endif

    source "libraries/HAL_Drivers/Kconfig"
       
endmenu

menu "Board extended module Drivers"

endmenu

endmenu
```
